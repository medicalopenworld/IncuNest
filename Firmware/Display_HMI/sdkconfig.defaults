## Firmware/SensorBoard/test_apps/comm_test/sdkconfig.defaults
```kconfig
# Console via USB CDC to see Unity output
CONFIG_ESP_CONSOLE_USB_CDC=y
CONFIG_TINYUSB_CDC_ENABLED=y
CONFIG_SPIRAM=y
CONFIG_SPIRAM_MODE_OCT=y
CONFIG_SPIRAM_SPEED_80M=y
CONFIG_ESPTOOLPY_FLASHSIZE_16MB=y
CONFIG_PARTITION_TABLE_CUSTOM=y
CONFIG_PARTITION_TABLE_CUSTOM_FILENAME="partitions.csv"
```

## Firmware/SensorBoard_v2/components/camera_sensor/Kconfig
```kconfig
menu "SensorBoard camera_sensor"

    config SB_CAM_JPEG_QUALITY
        int "Calidad JPEG (menor = mejor)"
        default 12
        range 5 40

    config SB_CAM_XCLK_HZ
        int "Frecuencia XCLK (Hz)"
        default 20000000
        range 8000000 24000000

endmenu
```

## Firmware/SensorBoard_v2/components/door_sensor/Kconfig
```kconfig
menu "SensorBoard door_sensor"

    config SB_DOOR_DEBOUNCE_MS
        int "Ventana de debounce (ms)"
        default 250
        range 50 5000
        help
            El DRV5032FB muestrea internamente a ~5 Hz (200 ms): la ventana
            debe ser >= a ese periodo para leer un nivel ya asentado.

    config SB_DOOR_ACTIVE_LOW
        bool "Nivel bajo = iman presente = puerta cerrada"
        default y

    config SB_DOOR_REASSERT_S
        int "Re-asercion periodica del estado (segundos)"
        default 30
        range 5 600
        help
            Sin cambios de puerta, el estado actual se reemite cada N
            segundos: un evento perdido por backpressure USB se autocorrige
            y la motherboard puede reconciliar (el modelo edge-only es lossy).

endmenu
```

## Firmware/SensorBoard_v2/components/env_sensors/Kconfig
```kconfig
menu "SensorBoard env_sensors"

    config SB_ENV_POLL_PERIOD_S
        int "Periodo de polling de sensores (segundos)"
        default 1
        range 1 3600
        help
            1 s, y no 5, porque estas lecturas son la VARIABLE DE CONTROL del
            PID de aire de la motherboard, no telemetria: alli el sensor de
            aire se declara averiado a los 5 s sin lectura fresca
            (MINIMUM_SUCCESSFULL_AIR_SENSOR_UPDATE) y esa alarma es de
            prioridad ALTA y corta el calefactor. Con cadencia de 5 s una sola
            publicacion perdida -- y se descartan sin reintento cuando el host
            no drena -- cortaba la calefaccion. Con 1 s hay 5 oportunidades
            antes de declarar el fallo. No subir este valor sin mirar
            SB_ENV_STALE_MS en la motherboard.

    config SB_ENV_I2C_SCAN
        bool "Escanear los buses I2C al arrancar (diagnostico via logs)"
        default y
        help
            Sondea 0x08-0x77 en cada bus tras crearlo y loguea que
            direcciones responden. ~1-2s extra de arranque; desactivar
            en produccion si no se necesita.

    config SB_ALS_UV_PER_LUX
        int "ALS: microvoltios por lux (placeholder SIN calibrar)"
        default 1000
        range 1 1000000
        help
            Factor de conversion mV->lux del ALS-PT19. Depende de la
            resistencia de carga del esquema. PENDIENTE de calibracion
            contra luxometro; el valor por defecto es un placeholder.

endmenu
```

## Firmware/SensorBoard_v2/components/mic_sensor/Kconfig
```kconfig
menu "SensorBoard mic_sensor"

    config SB_MIC_SAMPLE_RATE_HZ
        int "Frecuencia de muestreo PDM (Hz)"
        default 16000
        range 8000 48000

    config SB_MIC_WINDOW_MS
        int "Ventana de calculo RMS (ms)"
        default 1000
        range 100 5000

    config SB_MIC_PUBLISH_PERIOD_S
        int "Periodo de publicacion de sound_level (segundos)"
        default 1
        range 1 600
        help
            Con el periodo igual a la ventana (1 s) la medida es continua:
            las ventanas se encadenan sin pausa y no se pierde ningun ruido.
            La alarma de ruido de la motherboard (ALARM_NOISE_HIGH, 10 s)
            cuenta con lecturas seguidas. Con un periodo mayor se escucha
            solo una ventana de cada periodo.

    config SB_MIC_DB_OFFSET_TENTHS
        int "Offset de calibracion dBFS->SPL (decimas de dB)"
        default 1200
        range 0 2000
        help
            Sensibilidad del ICS-41350: -26 dBFS @ 94 dB SPL => offset 120 dB
            (1200 decimas). Ajustar contra sonometro; el valor publicado NO
            lleva ponderacion A todavia (diferido, ver README).

endmenu
```

## Firmware/SensorBoard_v2/components/usb_comm/Kconfig
```kconfig
menu "SensorBoard usb_comm"

    config SB_USB_AUTOSWAP
        bool "Intercambiar D+/D- automaticamente si el host no enumera"
        default y
        help
            SensorBoard HW_NUM 4: el conector USB admite dos orientaciones
            y en una de ellas D+/D- (IO20/IO19) llegan cruzados. Si tras un
            bus reset del host este no habla al dispositivo (ni SETUP ni
            SET_CONFIGURATION) en el plazo configurado, usb_comm intercambia
            los pines en el PHY del ESP32-S3 (exchg_pins) con detach/attach,
            una vez por reset visto; sin host no alterna. Con host activo
            nunca intercambia,
            asi que dejarlo activo en la V5 (conector corregido en
            hardware) es inocuo: solo actua cuando nadie enumera. Se expone
            como sensors.usb_swap en la resp de status (ADR-0003).

    config SB_USB_AUTOSWAP_TIMEOUT_MS
        int "Plazo sin host activo antes de intercambiar D+/D- (ms)"
        depends on SB_USB_AUTOSWAP
        default 2000
        range 1500 10000
        help
            Cota inferior 1500 ms: debe superar debounce de conexion del
            host (~100 ms) + bus reset + primer SETUP + debounce de
            enumeracion de pilas host como la de ESP-IDF (~250 ms) con
            margen; un valor menor convertiria el autoswap en un oscilador
            que impide enumerar. En la orientacion invertida el arranque
            enumera aproximadamente este tiempo mas tarde.

    config SB_USB_SWAP_DETACH_MS
        int "Duracion del detach al intercambiar D+/D- (ms)"
        depends on SB_USB_AUTOSWAP
        default 1000
        range 250 5000
        help
            Tiempo que el dispositivo permanece desconectado (pull-ups
            retirados) entre el intercambio de pines y el re-attach. Debe
            superar la recuperacion del puerto raiz de la pila host de la
            motherboard (ESP-IDF 4.4.6): tras un fallo de enumeracion el
            puerto queda deshabilitado, la desconexion lo hace apagar y
            encender, y si el dispositivo se re-conecta antes de que el
            puerto este listo, el host no ve ninguna transicion y ambos se
            quedan esperando (banco 2026-09-03 con 250 ms). Windows recupera
            en ~100 ms; 1000 ms cubre ambos con margen.

    config SB_LOG_MIRROR_CONSOLE
        bool "Duplicar los logs a la consola (UART0) para depuracion en banco"
        default n
        help
            Ademas de emitirlos como frames JSON por USB, escribe cada ESP_LOG
            en la consola estandar. Solo tiene efecto si la consola no es
            NONE (CONFIG_ESP_CONSOLE_UART_DEFAULT). Util para ver que hace el
            SensorBoard mientras esta conectado a la motherboard, cuando el
            enlace USB no esta disponible para leerlo. Desactivado en
            produccion: la consola es NONE y UART0 no va a ningun sitio.

endmenu
```

## Firmware/motherBoard/main/Kconfig.projbuild
```kconfig
menu "IncuNest motherBoard"

    config INCUNEST_HW_NUM
        int "Revision de hardware (HW_NUM)"
        default 17
        range 16 18
        help
            Revision de la placa. Sustituye a los entornos IncuNest_V17 e
            IncuNest_V18 de platformio.ini, que solo se diferenciaban en el
            -DHW_NUM. board.h exige que este definido y cambia pines y
            periferico segun el valor (ver los bloques #if (HW_NUM >= 17)).

            Se elige con `idf.py menuconfig`, o de una vez con
            `idf.py -DCONFIG_INCUNEST_HW_NUM=18 build`.

    config INCUNEST_FTEST_SIM_ACT_ENABLED
        bool "Build de TALLER: activacion de SIM en el test de fabrica"
        default n
        help
            Sustituye a los entornos IncuNest_V17_factory / IncuNest_V18_factory
            de platformio.ini, que solo anadian -DFTEST_SIM_ACT_ENABLED=1.

            Activa el paso sim_act del test de fabrica, que llama a la API de
            Onomondo con ONOMONDO_API_KEY. Esa clave controla TODAS las SIM de
            la organizacion y el repo es publico: un binario construido con
            esto activado se queda en el taller y NUNCA va a
            flasher_tool/data/firmware/ ni a una release de GitHub (`strings`
            la saca entera). Con la opcion apagada la clave no se nombra y por
            tanto no esta en el binario.

endmenu
```
